## Config.in
```kconfig
# RuntipiOS - BR2_EXTERNAL Configuration
#
# This file defines the external configuration options for RuntipiOS
# Additional packages and configuration can be added here

source "$BR2_EXTERNAL_RUNTIPIOS_PATH/package/runtipi/Config.in"
```

## board/runtipi/configs/rpi4-64_defconfig
```kconfig
# RuntipiOS Buildroot Configuration - Raspberry Pi 4/5 (64-bit)
BR2_aarch64=y
BR2_PACKAGE_HOST_LINUX_HEADERS_CUSTOM_6_1=y
BR2_PLATFORM_RESNPRINTF=y
BR2_ROOTFS_DEVICE_CREATION_DYNAMIC_UDEV=y
BR2_INIT_SYSTEMD=y
BR2_SYSTEMD_ENABLE_COREDUMP=y
BR2_PACKAGE_SYSTEMD=y
BR2_PACKAGE_SYSTEMD_NETWORKD=y
BR2_PACKAGE_SYSTEMD_RESOLVED=y
BR2_PACKAGE_SYSTEMD_TIMESYNCD=y
BR2_PACKAGE_DBUS=y
BR2_PACKAGE_DHCPCD=y
BR2_PACKAGE_AVAHI=y
BR2_PACKAGE_AVAHI_DAEMON=y
BR2_PACKAGE_WPA_SUPPLICANT=y
BR2_PACKAGE_HOSTAPD=y
BR2_PACKAGE_DNSMASQ=y
BR2_PACKAGE_IPTABLES=y
BR2_PACKAGE_IPROUTE2=y
BR2_PACKAGE_ETHTOOL=y
BR2_PACKAGE_WIRELESS_TOOLS=y
BR2_PACKAGE_CRDA=y
BR2_PACKAGE_BUSYBOX=y
BR2_PACKAGE_UTIL_LINUX=y
BR2_PACKAGE_E2FSPROGS=y
BR2_PACKAGE_DOSFSTOOLS=y
BR2_PACKAGE_PARTED=y
BR2_TARGET_UBOOT=y
BR2_TARGET_UBOOT_VERSION="2024.10"
BR2_UBOOT_CUSTOM_GIT_REPO_URL="https://github.com/raspberrypi/u-boot.git"
BR2_LINUX_KERNEL=y
BR2_LINUX_KERNEL_VERSION="6.10.4"
BR2_LINUX_KERNEL_USE_CUSTOM_CONFIG=y
BR2_LINUX_KERNEL_CUSTOM_CONFIG_FILE="board/runtipi/linux-defconfig"
BR2_PACKAGE_LIGHTTPD=y
BR2_PACKAGE_CURL=y
BR2_PACKAGE_WGET=y
BR2_PACKAGE_CA_CERTIFICATES=y
BR2_PACKAGE_OPENSSH=y
BR2_PACKAGE_OPENSSH_SERVER=y
BR2_PACKAGE_NANO=y
BR2_PACKAGE_VIM=y
BR2_PACKAGE_LESS=y
BR2_PACKAGE_JQ=y
BR2_PACKAGE_HTOP=y
BR2_TARGET_LOCALTIME="Europe/Paris"
BR2_GENERATE_LOCALE="en_US.UTF-8 fr_FR.UTF-8"
BR2_SYSTEM_DEFAULT_PATH="/usr/local/sbin:/usr/local/bin:/usr/sbin:/usr/bin:/sbin:/bin"
BR2_TARGET_ROOTFS_SQUASHFS=y
BR2_TARGET_ROOTFS_SQUASHFS4_ZSTD=y
BR2_ROOTFS_OVERLAY="board/runtipi/rootfs-overlay"
BR2_ROOTFS_POST_BUILD_SCRIPT="board/runtipi/post-build.sh"
BR2_ROOTFS_POST_IMAGE_SCRIPT="board/runtipi/post-image.sh"
BR2_SYSTEM_HOSTNAME="runtipi"
BR2_SYSTEM_BANNER="RuntipiOS"
BR2_PACKAGE_SUDO=y
BR2_PACKAGE_SHADOW=y
BR2_PACKAGE_PIGZ=y
BR2_PACKAGE_UNZIP=y
TZ="Europe/Paris"
```

## configs/runtipios_rpi4_64_defconfig
```kconfig
# RuntipiOS Buildroot Configuration for Raspberry Pi 4 (64-bit)
# Based on raspberrypi4_64_defconfig

# Target architecture
BR2_aarch64=y
BR2_cortex_a72=y

# System
BR2_SYSTEM_DHCP="eth0"
BR2_TARGET_GENERIC_HOSTNAME="runtipios"
BR2_TARGET_GENERIC_ISSUE="Welcome to RuntipiOS"
BR2_ROOTFS_DEVICE_CREATION_DYNAMIC_EUDEV=y

# Kernel
BR2_LINUX_KERNEL=y
BR2_LINUX_KERNEL_CUSTOM_TARBALL=y
BR2_LINUX_KERNEL_CUSTOM_TARBALL_LOCATION="https://github.com/raspberrypi/linux/archive/refs/heads/rpi-6.6.y.tar.gz"
BR2_LINUX_KERNEL_DEFCONFIG="bcm2711"
BR2_LINUX_KERNEL_DTS_SUPPORT=y
BR2_LINUX_KERNEL_INTREE_DTS_NAME="broadcom/bcm2711-rpi-4-b broadcom/bcm2711-rpi-400 broadcom/bcm2711-rpi-cm4"
BR2_LINUX_KERNEL_NEEDS_HOST_OPENSSL=y

# Firmware
BR2_PACKAGE_RPI_FIRMWARE=y
BR2_PACKAGE_RPI_FIRMWARE_VARIANT_PI4=y
BR2_PACKAGE_RPI_FIRMWARE_CONFIG_FILE="board/runtipi/config.txt"

# Filesystem
BR2_TARGET_ROOTFS_EXT2=y
BR2_TARGET_ROOTFS_EXT2_4=y
BR2_TARGET_ROOTFS_EXT2_SIZE="1500M"
# BR2_TARGET_ROOTFS_TAR is not set

# Bootloader - disabled for now
# BR2_TARGET_UBOOT is not set

# Systemd packages
# Bootloader - disabled for now
# BR2_TARGET_UBOOT is not set

# Systemd packages
BR2_PACKAGE_SYSTEMD=y
BR2_PACKAGE_SYSTEMD_NETWORKD=y
BR2_PACKAGE_SYSTEMD_RESOLVED=y
BR2_PACKAGE_SYSTEMD_TIMESYNCD=y

# Network
BR2_PACKAGE_DBUS=y
BR2_PACKAGE_DHCPCD=y
BR2_PACKAGE_WPA_SUPPLICANT=y
BR2_PACKAGE_WPA_SUPPLICANT_CLI=y
BR2_PACKAGE_HOSTAPD=y
BR2_PACKAGE_DNSMASQ=y
BR2_PACKAGE_IPTABLES=y
BR2_PACKAGE_IPROUTE2=y
BR2_PACKAGE_ETHTOOL=y
BR2_PACKAGE_WIRELESS_TOOLS=y
BR2_PACKAGE_WIRELESS_REGDB=y

# Web server
BR2_PACKAGE_LIGHTTPD=y

# Essential utilities
BR2_PACKAGE_BASH=y
BR2_PACKAGE_UTIL_LINUX=y
BR2_PACKAGE_E2FSPROGS=y
BR2_PACKAGE_DOSFSTOOLS=y
BR2_PACKAGE_SUDO=y

# Network tools
BR2_PACKAGE_CURL=y
BR2_PACKAGE_WGET=y
BR2_PACKAGE_OPENSSH=y
BR2_PACKAGE_CA_CERTIFICATES=y

# Development tools
BR2_PACKAGE_GIT=y
BR2_PACKAGE_JQ=y
BR2_PACKAGE_NANO=y

# Python
BR2_PACKAGE_PYTHON3=y

# Custom packages
BR2_PACKAGE_RUNTIPI=y

# Post-build/image scripts
BR2_ROOTFS_OVERLAY="board/runtipi/rootfs-overlay"
BR2_ROOTFS_POST_BUILD_SCRIPT="board/runtipi/post-build.sh"
BR2_ROOTFS_POST_IMAGE_SCRIPT="board/runtipi/post-image.sh support/scripts/genimage.sh"
BR2_ROOTFS_POST_SCRIPT_ARGS="-c board/runtipi/genimage.cfg"

# genimage
BR2_PACKAGE_HOST_GENIMAGE=y
BR2_PACKAGE_HOST_DOSFSTOOLS=y
BR2_PACKAGE_HOST_MTOOLS=y
```

## configs/runtipios_rpi5_64_defconfig
```kconfig
# RuntipiOS Buildroot Configuration for Raspberry Pi 5 (64-bit)
# Minimal defconfig based on raspberrypi5_defconfig

BR2_aarch64=y
BR2_cortex_a76=y

# Linux headers same as kernel
BR2_PACKAGE_HOST_LINUX_HEADERS_CUSTOM_6_6=y

BR2_TOOLCHAIN_BUILDROOT_CXX=y

BR2_SYSTEM_DHCP="eth0"

BR2_LINUX_KERNEL=y
BR2_LINUX_KERNEL_CUSTOM_TARBALL=y
BR2_LINUX_KERNEL_CUSTOM_TARBALL_LOCATION="$(call github,raspberrypi,linux,576cc10e1ed50a9eacffc7a05c796051d7343ea4)/linux-576cc10e1ed50a9eacffc7a05c796051d7343ea4.tar.gz"
BR2_LINUX_KERNEL_DEFCONFIG="bcm2712"
BR2_LINUX_KERNEL_DTS_SUPPORT=y
BR2_LINUX_KERNEL_INTREE_DTS_NAME="broadcom/bcm2712-rpi-5-b"
BR2_LINUX_KERNEL_NEEDS_HOST_OPENSSL=y

BR2_PACKAGE_RPI_FIRMWARE=y
BR2_PACKAGE_RPI_FIRMWARE_CONFIG_FILE="board/runtipi/config_rpi5.txt"

# Required tools to create the SD image
BR2_PACKAGE_HOST_DOSFSTOOLS=y
BR2_PACKAGE_HOST_GENIMAGE=y
BR2_PACKAGE_HOST_MTOOLS=y

# Filesystem / image
BR2_TARGET_ROOTFS_EXT2=y
BR2_TARGET_ROOTFS_EXT2_4=y
BR2_TARGET_ROOTFS_EXT2_SIZE="1500M"
# BR2_TARGET_ROOTFS_TAR is not set

BR2_ROOTFS_OVERLAY="board/runtipi/rootfs-overlay"
BR2_ROOTFS_POST_BUILD_SCRIPT="board/runtipi/post-build.sh"
BR2_ROOTFS_POST_IMAGE_SCRIPT="board/runtipi/post-image.sh"

# Init system
BR2_INIT_SYSTEMD=y
BR2_PACKAGE_SYSTEMD_NETWORKD=y
BR2_PACKAGE_SYSTEMD_RESOLVED=y

# Network essentials
BR2_PACKAGE_DHCPCD=y
BR2_PACKAGE_WPA_SUPPLICANT=y
BR2_PACKAGE_WPA_SUPPLICANT_CLI=y
BR2_PACKAGE_HOSTAPD=y
BR2_PACKAGE_DNSMASQ=y

# Utilities
BR2_PACKAGE_BUSYBOX_SHOW_OTHERS=y
BR2_PACKAGE_UTIL_LINUX=y
BR2_PACKAGE_E2FSPROGS=y
BR2_PACKAGE_DOSFSTOOLS=y

# Network tools
BR2_PACKAGE_LIBCURL=y
BR2_PACKAGE_LIBCURL_CURL=y
BR2_PACKAGE_WGET=y
BR2_PACKAGE_OPENSSH=y
BR2_PACKAGE_CA_CERTIFICATES=y

# Development
BR2_PACKAGE_GIT=y
BR2_PACKAGE_NANO=y

# Python for scripts
BR2_PACKAGE_PYTHON3=y

# Custom packages
BR2_PACKAGE_RUNTIPI=y
```

## package/runtipi/Config.in
```kconfig
config BR2_PACKAGE_RUNTIPI
	bool "runtipi"
	depends on BR2_PACKAGE_BUSYBOX_SHOW_OTHERS
	select BR2_PACKAGE_CURL
	select BR2_PACKAGE_CA_CERTIFICATES
	help
	  Runtipi is a home server management system that lets you
	  self-host services like Nextcloud, Jellyfin, and more with
	  one-click installations.
	  
	  Docker will be installed automatically by Runtipi's installer.

	  https://runtipi.io
```
